## meta-iotdemo/conf/distro/iotdemo.conf
```bitbake
require conf/distro/poky.conf

DISTRO = "iotdemo"
DISTRO_NAME = "IoT Demo Distribution"
DISTRO_VERSION = "1.0"

DISTRO_FEATURES:append = " usrmerge systemd ipv4 ipv6 rauc wifi wpa"
INIT_MANAGER = "systemd"

DISTRO_FEATURES:remove = "x11 wayland opengl"
LICENSE_FLAGS_ACCEPTED += "synaptics-killswitch"

IMAGE_LINGUAS = "en-us"

EXTRA_IMAGE_FEATURES:append = " debug-tweaks"
```

## meta-iotdemo/conf/layer.conf
```bitbake
BBPATH .= ":${LAYERDIR}"
BBFILES += "${LAYERDIR}/recipes-*/*/*.bb ${LAYERDIR}/recipes-*/*/*.bbappend"

BBFILE_COLLECTIONS += "iotdemo"
BBFILE_PATTERN_iotdemo = "^${LAYERDIR}/"
BBFILE_PRIORITY_iotdemo = "10"

LAYERDEPENDS_iotdemo = "core rauc raspberrypi"
LAYERSERIES_COMPAT_iotdemo = "scarthgap"
```
